
/*
 * freqs.dtsi
 *
 * by morogoku
 *
 */

/ {
	cpufreq {
		compatible = "samsung,exynos-mp-cpufreq";

		/* For CPUFREQ table */
 		/* APO */
		cl0_idx_num = <19>;
		cl0_max_support_idx = <4>;
		cl0_min_support_idx = <18>;
		cl0_boot_max_qos = <1586000>;
		cl0_boot_min_qos = <1586000>;
		cl0_en_ema = <1>;

		/* MNGS */
		cl1_idx_num = <28>;
		cl1_max_support_idx = <7>;
		cl1_min_support_idx = <27>;
		cl1_boot_max_qos = <2288000>;
		cl1_boot_min_qos = <2288000>;
		cl1_en_ema = <1>;
		cl1_en_smpl = <1>;
		cl1_jig_boot_max_qos = <1456000>;
		cl1_reboot_limit_freq = <728000>;

		cl1_max_support_idx_table = < 7	   /* Number of online core is 0 */
 					      4    /* Number of online core is 1 */
 					      4    /* Number of online core is 2 */
 					      7    /* Number of online core is 3 */
					      7 >; /* Number of online core is 4 */

		/* Boost freq*/
		cl0_boost_freq = <754000>;

		/*APO table -> idx freq volt bus_lock */
		cl0_dvfs_domain_name = "dvfs_little";
		cl0_dvfs_table = < 0  1976000 1100000        0   /* ARM L0: 2.0GHz   */
				   1  1898000 1100000        0   /* ARM L1: 1.9GMHz  */
				   2  1794000 1100000        0   /* ARM L2: 1.8GMHz  */
				   3  1690000 1100000        0   /* ARM L3: 1.7GHz   */
				   4  1586000 1162500  1014000   /* ARM L4: 1.6GHz   */
				   5  1482000 1100000  1014000   /* ARM L5: 1.5GMHz  */
				   6  1378000 1037500  1014000   /* ARM L6: 1.4GMHz  */
				   7  1274000  987500  1014000   /* ARM L7: 1.3GHz   */
				   8  1170000  937500   845000   /* ARM L8: 1.2GHz   */
				   9  1066000  887500   845000   /* ARM L9: 1.1GHz   */
				  10   962000  850000   845000   /* ARM L10: 1000MHz */
				  11   858000  812500   676000   /* ARM L11: 900MHz  */
				  12   754000  781250   676000   /* ARM L12: 800MHz  */
				  13   650000  750000   546000   /* ARM L13: 700MHz  */
				  14   546000  718750   421000   /* ARM L14: 500MHz  */
				  15   442000  681250	     0   /* ARM L15: 400MHz  */
				  16   338000  650000	     0   /* ARM L16: 300MHz  */
				  17   234000  643750	     0   /* ARM L17: 200MHz  */
				  18   130000  643750	     0 >;/* ARM L18: 100MHz  */

		/*MNGS table -> idx freq volt bus_lock */
		cl1_dvfs_domain_name = "dvfs_big";
		cl1_dvfs_table = < 0 3000000 1137500   1794000 /* ARM L0: 3.0GHz  */
				   1 2900000 1137500   1794000 /* ARM L1: 2.9GMHz */
				   2 2800000 1137500   1794000 /* ARM L2: 2.8GMHz */
				   3 2700000 1137500   1794000 /* ARM L3: 2.7GHz  */
				   4 2600000 1137500   1794000 /* ARM L4: 2.6GHz  */
				   5 2496000 1137500   1716000 /* ARM L5: 2.5GHz  */
				   6 2392000 1268750   1716000 /* ARM L6: 2.4GHz  */
				   7 2288000 1187500   1716000 /* ARM L7: 2.3GHz  */
				   8 2184000 1131250   1539000 /* ARM L8: 2.2GHz  */
				   9 2080000 1081250   1539000 /* ARM L9: 2.1GHz  */
				  10 1976000 1037500   1352000 /* ARM L10: 2.0GHz */
				  11 1872000 1000000   1144000 /* ARM L11: 1.9GHz */
				  12 1768000  962500   1144000 /* ARM L12: 1.8GHz */
				  13 1664000  931250   1014000 /* ARM L13: 1.7GHz */
				  14 1560000  900000   1014000 /* ARM L14: 1.6GHz */
				  15 1456000  868750    845000 /* ARM L15: 1.5GHz */
				  16 1352000  843750    845000 /* ARM L16: 1.4MHz */
				  17 1248000  837500    676000 /* ARM L17: 1.3MHz */
				  18 1144000  837500    546000 /* ARM L18: 1.2MHz */
				  19 1040000  837500    546000 /* ARM L19: 1.0MHz */
				  20  936000  837500    421000 /* ARM L20: 900MHz */
				  21  832000  837500    421000 /* ARM L21: 800MHz */
				  22  728000  837500    421000 /* ARM L22: 700MHz */
				  23  624000  837500       0   /* ARM L23: 600MHz */
				  24  520000  837500       0   /* ARM L23: 500MHz */
				  25  416000  837500       0   /* ARM L23: 400MHz */
				  26  312000  837500       0   /* ARM L23: 300MHz */
				  27  208000  837500       0 >;/* ARM L23: 200MHz */
	};
};
