## arch/arm64/configs/moro-edge-r22_defconfig
```kconfig
# CONFIG_WLAN_HERO is not set
CONFIG_WLAN_HERO2=y
CONFIG_FB_DSU_REG_LOCK=y
CONFIG_EXYNOS_DECON_LCD_MCD=y
# CONFIG_LCD_ESD_IDLE_MODE is not set
CONFIG_PANEL_S6E3HF4_WQHD=y
# CONFIG_PANEL_S6E3HA3_DYNAMIC is not set
# CONFIG_PANEL_DUALIZATION is not set
CONFIG_SENSORS_SX9310_NORMAL_TOUCH_THRESHOLD=168
CONFIG_SENSORS_HERO2=y

#
# GPU
#
# CONFIG_MALI_R15P0 is not set
CONFIG_MALI_R22P0=y
# CONFIG_MALI_PLATFORM_THIRDPARTY is not set
# CONFIG_MALI_PLATFORM_THIRDPARTY_NAME="exynos"
CONFIG_MALI_PLATFORM_NAME="exynos"
```

## arch/arm64/configs/moro-flat-n8_defconfig
```kconfig
CONFIG_WLAN_HERO=y
# CONFIG_WLAN_HERO2 is not set
# CONFIG_FB_DSU_REG_LOCK is not set
# CONFIG_EXYNOS_DECON_LCD_MCD is not set
CONFIG_LCD_ESD_IDLE_MODE=y
# CONFIG_PANEL_S6E3HF4_WQHD is not set
CONFIG_PANEL_S6E3HA3_DYNAMIC=y
# CONFIG_PANEL_DUALIZATION is not set
CONFIG_SENSORS_SX9310_NORMAL_TOUCH_THRESHOLD=176
# CONFIG_SENSORS_HERO2 is not set
CONFIG_IP_NF_MATCH_RPFILTER=y
CONFIG_IP6_NF_MATCH_RPFILTER=y

#
# ARM GPU Configuration
#
CONFIG_MALI_R12P0=y
# CONFIG_MALI_R15P0 is not set
# CONFIG_MALI_DMA_FENCE is not set
# CONFIG_MALI_PRFCNT_SET_SECONDARY is not set
# CONFIG_MALI_MIDGARD is not set
# CONFIG_MALI_GATOR_SUPPORT is not set
# CONFIG_MALI_MIDGARD_DVFS is not set
# CONFIG_MALI_CORESTACK is not set
# CONFIG_MALI_FENCE_DEBUG is not set
# CONFIG_MALI_GPU_MMU_AARCH64 is not set
# CONFIG_MALI_SEC_CL_BOOST is not set
# CONFIG_MALI_SEC_UTILIZATION is not set
# CONFIG_MALI_PM_QOS is not set
# CONFIG_MALI_BTS_OPTIMIZATION is not set
# CONFIG_MALI_DEBUG_KERNEL_SYSFS is not set
# CONFIG_MALI_EXYNOS_SECURE_RENDERING is not set
# CONFIG_MALI_SEC_ASP_SECURE_BUF_CTRL is not set
```

## arch/arm64/configs/moro-flat_defconfig
```kconfig
#
# S7 FLAT
#
CONFIG_WLAN_HERO=y
# CONFIG_WLAN_HERO2 is not set
# CONFIG_FB_DSU_REG_LOCK is not set
# CONFIG_EXYNOS_DECON_LCD_MCD is not set
CONFIG_LCD_ESD_IDLE_MODE=y
# CONFIG_PANEL_S6E3HF4_WQHD is not set
CONFIG_PANEL_S6E3HA3_DYNAMIC=y
# CONFIG_PANEL_DUALIZATION is not set
CONFIG_SENSORS_SX9310_NORMAL_TOUCH_THRESHOLD=176
# CONFIG_SENSORS_HERO2 is not set
```

## arch/arm64/configs/moro-oreo_defconfig
```kconfig
#
# OREO Stock
#
# CONFIG_WLAN_GRACE is not set
CONFIG_CAMERA_HERO=y
# CONFIG_CAMERA_GRACE is not set
CONFIG_DDK_VERSION_OS="o"
```

## arch/arm64/configs/moro-pie_defconfig
```kconfig
#
# PIE Port
#
CONFIG_WLAN_GRACE=y
# CONFIG_CAMERA_HERO is not set
CONFIG_CAMERA_GRACE=y
CONFIG_DDK_VERSION_OS="p"
```

## drivers/usb/typec/Kconfig
```kconfig
menu "USB Power Delivery and Type-C drivers"

config TYPEC
	tristate
	default y if MODEL_GRACELTE
	default y if MODEL_GRACELTEKOR
	depends on ANDROID_MAJOR_VERSION != "n"
	depends on ANDROID_MAJOR_VERSION != "o"

endmenu
```
